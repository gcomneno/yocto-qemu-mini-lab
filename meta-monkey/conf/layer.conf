## meta-monkey/conf/layer.conf
```bitbake
# We have a conf and classes directory, add to BBPATH
BBPATH .= ":${LAYERDIR}"

# We have recipes-* directories, add to BBFILES
BBFILES += "${LAYERDIR}/recipes-*/*/*.bb \
            ${LAYERDIR}/recipes-*/*/*.bbappend"

BBFILE_COLLECTIONS += "meta-monkey"
BBFILE_PATTERN_meta-monkey = "^${LAYERDIR}/"
BBFILE_PRIORITY_meta-monkey = "6"

LAYERDEPENDS_meta-monkey = "core"
LAYERSERIES_COMPAT_meta-monkey = "walnascar"
```
